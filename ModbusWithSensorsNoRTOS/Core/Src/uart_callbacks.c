/**
 * @file    uart_callbacks.c
 * @brief   UART callback functions for Modbus processing
 * @author  Generated by Copilot
 */

#include "uart_callbacks.h"
#include "modbus_init.h"
#include "modbus.h"

/* Private variables ---------------------------------------------------------*/
extern UART_HandleTypeDef huart1;

/* Private function prototypes -----------------------------------------------*/

/* Exported functions -------------------------------------------------------*/

/**
 * @brief  Initialize UART callbacks
 * @param  None
 * @retval None
 */
void UART_Callbacks_Init(void)
{
    // UART callbacks are handled by HAL, this function can be used
    // for any additional initialization if needed
}

/* HAL UART Callbacks -------------------------------------------------------*/

/**
 * @brief  UART receive event callback (called when DMA receives data)
 * @param  huart: UART handle
 * @param  Size: Number of bytes received
 * @retval None
 */
void HAL_UARTEx_RxEventCallback(UART_HandleTypeDef *huart, uint16_t Size)
{
    if (huart == &huart1 && Size > 0)
    {
        // Get Modbus context
        mbus_t modbus_ctx = Modbus_GetContext();

        // Mark Modbus activity for recovery system
        ModbusRecovery_MarkActivity();

        // Validate context before processing
        if (modbus_ctx >= 0)
        {
            // Process received Modbus data byte by byte
            for (uint16_t i = 0; i < Size && i < sizeof(modbus_rx_buffer); i++)
            {
                mbus_poll(modbus_ctx, modbus_rx_buffer[i]);
            }
        } // Clear the UART idle flag
        __HAL_UART_CLEAR_IDLEFLAG(huart);

        // Restart DMA reception for next frame
        HAL_UARTEx_ReceiveToIdle_DMA(&huart1, modbus_rx_buffer, sizeof(modbus_rx_buffer));
    }
}

/**
 * @brief  UART error callback
 * @param  huart: UART handle
 * @retval None
 */
void HAL_UART_ErrorCallback(UART_HandleTypeDef *huart)
{
    if (huart == &huart1)
    {
        // Mark error for recovery system
        ModbusRecovery_MarkError();

        // Handle UART errors
        __HAL_UART_CLEAR_OREFLAG(huart);
        __HAL_UART_CLEAR_NEFLAG(huart);
        __HAL_UART_CLEAR_FEFLAG(huart);

        // Restart DMA reception
        HAL_UARTEx_ReceiveToIdle_DMA(&huart1, modbus_rx_buffer, sizeof(modbus_rx_buffer));
    }
}

/**
 * @brief  UART abort callback
 * @param  huart: UART handle
 * @retval None
 */
void HAL_UART_AbortCpltCallback(UART_HandleTypeDef *huart)
{
    if (huart == &huart1)
    {
        // Handle UART abort
        HAL_UARTEx_ReceiveToIdle_DMA(&huart1, modbus_rx_buffer, sizeof(modbus_rx_buffer));
    }
}

/**
 * @brief  UART abort transmit callback
 * @param  huart: UART handle
 * @retval None
 */
void HAL_UART_AbortTransmitCpltCallback(UART_HandleTypeDef *huart)
{
    if (huart == &huart1)
    {
        // Handle UART abort transmit
    }
}

/**
 * @brief  UART abort receive callback
 * @param  huart: UART handle
 * @retval None
 */
void HAL_UART_AbortReceiveCpltCallback(UART_HandleTypeDef *huart)
{
    if (huart == &huart1)
    {
        // Handle UART abort receive
        HAL_UARTEx_ReceiveToIdle_DMA(&huart1, modbus_rx_buffer, sizeof(modbus_rx_buffer));
    }
}